## buildroot/Config.in
```kconfig
menu "Giochi Konsol OS"

source "$BR2_EXTERNAL_GIOCHI_PATH/package/giochi-init/Config.in"
source "$BR2_EXTERNAL_GIOCHI_PATH/package/giochi-musicd/Config.in"
source "$BR2_EXTERNAL_GIOCHI_PATH/package/giochi-launcher/Config.in"
source "$BR2_EXTERNAL_GIOCHI_PATH/package/giochi-assets/Config.in"
source "$BR2_EXTERNAL_GIOCHI_PATH/package/giochi-tools/Config.in"
source "$BR2_EXTERNAL_GIOCHI_PATH/package/giochi-mtpd/Config.in"

config BR2_PACKAGE_GIOCHI_PROTON
	bool "habilitar stub Proton (GIOCHI_ENABLE_PROTON)"
	default n
	help
	  Secao 4.10 / ADR: Proton NAO e implementado na v1.2. A flag existe
	  apenas para destravar a compilacao futura; com 'n' o custo e zero.

config BR2_PACKAGE_GIOCHI_DONGLES
	bool "incluir modulos .ko e firmware de dongles USB"
	default y
	help
	  ADR-14: Wi-Fi/Bluetooth opcionais via dongle USB. Os modulos sao
	  instalados em /lib/modules e NAO sao carregados no boot.

endmenu
```

## buildroot/package/giochi-assets/Config.in
```kconfig
config BR2_PACKAGE_GIOCHI_ASSETS
	bool "giochi-assets (layouts, tema, defaults)"
	default y
	help
	  Instala layout.json (schema 1.6), home/library/music.json,
	  theme.json e defaults.json em /usr/share/giochi.
```

## buildroot/package/giochi-games/Config.in
```kconfig
config BR2_PACKAGE_GIOCHI_GAMES
	bool "giochi-games"
	depends on BR2_PACKAGE_GIOCHI_LAUNCHER
	help
	  Jogos padrao do Giochi Konsol OS (assets/default-games.json):
	  Spacewar, Colossal Cave e Arcade Volleyball.

	  Todos sao de dominio publico, de livre distribuicao com permissao dos
	  autores, ou codigo/arte escritos neste repositorio (ver o campo
	  "license" de cada entrada no manifesto e tools/check-default-games.py).

	  Instala os projetos Godot em /usr/share/giochi/games/<id> e o
	  manifesto em /usr/share/giochi/default-games.json. Serve de teste e
	  de benchmark do aparelho via `giochi-bench` (scripts/giochi-bench).

	  O template de export do Godot (aarch64/musl, ADR-03) ainda NAO esta
	  no Buildroot: sem ele, o pacote instala os projetos, nao binarios
	  prontos. Ver docs/GAMES.md.
```

## buildroot/package/giochi-init/Config.in
```kconfig
config BR2_PACKAGE_GIOCHI_INIT
	bool "giochi-init"
	depends on BR2_USE_MMU
	help
	  Supervisor (ADR-10): pai do Launcher, jogos, apps e daemons.
	  Expoe /run/giochi/control.sock (comandos de texto), a FIFO
	  /run/giochi/transition e regenera device_profile.json no boot.

if BR2_PACKAGE_GIOCHI_INIT

config BR2_PACKAGE_GIOCHI_INIT_SOC
	string "SoC alvo (rk3326|rk3566)"
	default "rk3326"
	help
	  Seleciona os valores embutidos em device_profile.json.

config BR2_PACKAGE_GIOCHI_INIT_DEVICE
	string "aparelho de referencia (generic|x55|x35s|x35h)"
	default "generic"
	help
	  Perfil de hardware de docs/hardware-e-drivers.md §1. Em rk3566:
	    x55   -> painel 720x1280, Wi-Fi/BT integrados (RTL8821CS)
	    x35s  -> painel 640x480, rádio nao medido, USB nao ancora (F12)
	    x35h  -> mesmo DTB da x35s, sem radio integrado, USB nao ancora
	  Fora desses nomes usa os valores genericos do SoC.

endif
```

## buildroot/package/giochi-launcher/Config.in
```kconfig
config BR2_PACKAGE_GIOCHI_LAUNCHER
	bool "giochi-launcher"
	depends on BR2_USE_MMU
	depends on BR2_TOOLCHAIN_HAS_THREADS
	depends on BR2_INSTALL_LIBSTDCPP
	select BR2_PACKAGE_SDL2
	help
	  Launcher C++17 + SDL2 (ADR-09): motor de layout schema 1.6,
	  5 abas, grid 4x3 e overlay de Configuracoes.
```

## buildroot/package/giochi-mtpd/Config.in
```kconfig
config BR2_PACKAGE_GIOCHI_MTPD
	bool "giochi-mtpd (uMTP-Responder)"
	depends on BR2_USE_MMU
	depends on BR2_TOOLCHAIN_HAS_THREADS
	help
	  Daemon MTP do Giochi Konsol OS (secao 4.6).

	  O f_mtp do kernel e apenas o transporte; o protocolo MTP precisa de
	  um responder no userspace. Sem este pacote o PC detecta o
	  dispositivo USB mas nao lista arquivos.

	  Usa uMTP-Responder (umtprd) sobre FunctionFS, leve e sem glib.

if BR2_PACKAGE_GIOCHI_MTPD

config BR2_PACKAGE_GIOCHI_MTPD_STORAGE
	string "ponto de montagem exposto por MTP"
	default "/user"
	help
	  Diretorio exposto ao PC. O padrao (/user) contem games/, music/,
	  ports/ e .giochi/, ou seja tudo o que o usuario copia.
endif
```

## buildroot/package/giochi-musicd/Config.in
```kconfig
config BR2_PACKAGE_GIOCHI_MUSIC
	bool "giochi-musicd (aba Musica)"
	depends on BR2_USE_MMU
	select BR2_PACKAGE_GIOCHI_MUSICD
	help
	  Alias historico da secao 4.8: habilita o daemon de musica.

config BR2_PACKAGE_GIOCHI_MUSICD
	bool "giochi-musicd (implementacao)"
	depends on BR2_USE_MMU
	select BR2_PACKAGE_ALSA_LIB
	help
	  Daemon de musica: ALSA direto (ADR-08) + socket texto em
	  /run/giochi/music.sock. Nao e morto ao lancar jogos.
```

## buildroot/package/giochi-portmaster/Config.in
```kconfig
config BR2_PACKAGE_GIOCHI_PORTMASTER
	bool "giochi-portmaster"
	select BR2_PACKAGE_BASH
	select BR2_PACKAGE_BUSYBOX_SHOW_OTHERS
	select BR2_PACKAGE_LIBCURL
	select BR2_PACKAGE_LIBCURL_CURL
	select BR2_PACKAGE_ZIP
	help
	  PortMaster — instalador de ports de jogos de PC (wrappers ARM64).

	  Instalado em /apps/PortMaster (a particao de dados, via o symlink
	  /apps) com o wrapper /apps/portmaster, que e' o alvo da aba Ports
	  do Launcher (APP:portmaster).

	  Exigencias de runtime: bash, curl (download dos ports), unzip/zip
	  (BusyBox). Nada disto estava na imagem antes: um port so' funciona
	  com rede (Wi-Fi) disponivel, que e' outro item aberto do projeto.

	  Licenca: MIT (nucleo do PortMaster); os componentes embutidos
	  (7zzs, innoextract, runtimes) tem licencas proprias em
	  /apps/PortMaster/licenses/.

	  Fonte: https://github.com/PortsMaster/PortMaster-GUI

	  NOTA: o zip oficial e' o bundle do muOS; o pacote remove as pastas
	  dos outros firmwares (batocera/knulli/trimui/...), ajusta o
	  controlfolder para /apps/PortMaster e escreve device_info.txt com
	  CFW_NAME=giochi (docs/APPS.md).
```

## buildroot/package/giochi-ppsspp/Config.in
```kconfig
config BR2_PACKAGE_GIOCHI_PPSSPP
	bool "giochi-ppsspp"
	select BR2_PACKAGE_SDL2
	select BR2_PACKAGE_SDL2_TTF
	select BR2_PACKAGE_ZLIB
	help
	  PPSSPP — emulador de PSP, build SDL (PPSSPPSDL) + headless
	  (PPSSPPHeadless, o "CLI").

	  Instalado em /apps/ppsspp com o wrapper /apps/ppsspp. Compila do
	  fonte (tag v1.17.1) com GLES2/EGL e SEM Qt/ffmpeg/discord: o
	  binario conversa com o Mesa do sistema (panfrost via kmsro), o
	  mesmo caminho que o Launcher usa.

	  Licenca: GPL-2.0 (com submodulos com licencas proprias).

	  Custo medido no host: assets 18 MB (sem vfpu ~13 MB) + binario.
	  Emulacao de PSP num RK3566/2 GB e' duvida de desempenho — registrado
	  em assets/engines.json (verified_on_device=false).

	  Fonte: https://github.com/hrydgard/ppsspp
```

## buildroot/package/giochi-tools/Config.in
```kconfig
config BR2_PACKAGE_GIOCHI_TOOLS
	bool "giochi-tools (verify, extract, thumbgen, pack)"
	default y
	select BR2_PACKAGE_OPENSSL
	select BR2_PACKAGE_LIBARCHIVE
	select BR2_PACKAGE_LIBPNG
	help
	  Utilitarios de instalacao e update: giochi-verify (S12),
	  giochi-extract e giochi-thumbgen (S9), giochi-pack.sh.
```
